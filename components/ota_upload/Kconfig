## components/ota_upload/Kconfig
```kconfig
menu "OTA Upload"

config OTA_UPLOAD_PORT
    int "Default OTA TCP port"
    range 1024 65535
    default 3232

config OTA_UPLOAD_ENABLE_MDNS
    bool "Enable mDNS advertisement"
    default y

config OTA_UPLOAD_TASK_STACK_SIZE
    int "OTA receiver task stack size"
    range 4096 16384
    default 6144

config OTA_UPLOAD_TASK_PRIORITY
    int "OTA receiver task priority"
    range 1 24
    default 5

config OTA_UPLOAD_REBOOT_AFTER_UPDATE
    bool "Reboot after successful OTA update"
    default y

endmenu
```

## components/ota_upload/examples/basic/main/Kconfig.projbuild
```kconfig
menu "Example configuration"

config EXAMPLE_USE_WIFI_PROVISIONING
    bool "Use Wi-Fi provisioning"
    default y
    help
        Enable Wi-Fi provisioning via BLE/SoftAP instead of hardcoded credentials.

config EXAMPLE_WIFI_SSID
    string "Wi-Fi SSID"
    default ""
    depends on !EXAMPLE_USE_WIFI_PROVISIONING
    help
        SSID used by the ota_upload development application (when provisioning disabled).

config EXAMPLE_WIFI_PASSWORD
    string "Wi-Fi password"
    default ""
    depends on !EXAMPLE_USE_WIFI_PROVISIONING
    help
        Password used by the ota_upload development application (when provisioning disabled).

endmenu
```

## main/Kconfig.projbuild
```kconfig
menu "Example configuration"

config EXAMPLE_WIFI_SSID
    string "Wi-Fi SSID"
    default ""
    help
        SSID used by the ota_manager development application.

config EXAMPLE_WIFI_PASSWORD
    string "Wi-Fi password"
    default ""
    help
        Password used by the ota_manager development application.

endmenu
```
